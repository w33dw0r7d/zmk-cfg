## boards/arm/skean/board.yml
```yaml
board:
  name: skean
  full_name: Skean
  vendor: tintsgrid
  socs:
    - name: nrf52840
      variants:
        - name: left
        - name: right
```

## boards/tintsgrid/skean/Kconfig.defconfig
```kconfig
# Copyright (c) 2021 The ZMK Contributors
# SPDX-License-Identifier: MIT

if BOARD_SKEAN_LEFT

config ZMK_KEYBOARD_NAME
    default "Skean"

config ZMK_SPLIT_ROLE_CENTRAL
    default y

endif # BOARD_SKEAN_LEFT


if BOARD_SKEAN_LEFT || BOARD_SKEAN_RIGHT

config BOARD
    default "skean"

config ZMK_SPLIT
    default y

config BT_CTLR
    default BT

config ZMK_BLE
    default y

config ZMK_BATTERY_VOLTAGE_DIVIDER
    default y

if USB

config USB_NRFX
    default y

config USB_DEVICE_STACK
    default y

endif # USB

endif # BOARD_SKEAN_LEFT || BOARD_SKEAN_RIGHT
```

## boards/tintsgrid/skean/Kconfig.skean_right
```kconfig
# Copyright (c) 2021 The ZMK Contributors
# SPDX-License-Identifier: MIT

config BOARD_SKEAN_RIGHT
    select SOC_NRF52833_QIAA
    select ZMK_BOARD_COMPAT
    imply RETAINED_MEM
    imply RETENTION
    imply RETENTION_BOOT_MODE
```

## boards/tintsgrid/skean/board.yml
```yaml
boards:
  - name: skean_left
    vendor: tintsgrid
    socs:
      - name: nrf52833
        variants:
          - name: zmk
  - name: skean_right
    vendor: tintsgrid
    socs:
      - name: nrf52833
        variants:
          - name: zmk
```

## config/west.yml
```yaml
manifest:
  remotes:
    - name: zmkfirmware
      url-base: https://github.com/zmkfirmware
    - name: krikun98
      url-base: https://github.com/krikun98
  projects:
    # - name: zmk
    #   remote: zmkfirmware
    #   revision: main
    #   import: app/west.yml
    - name: zmk
      remote: krikun98
      revision: nrf52833
      path: boards/nrfmicro_13_52833
      import: app/west.yml
  self:
    path: config
```
