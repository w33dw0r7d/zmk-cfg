/*
 * Copyright (c) 2021 The ZMK Contributors
 *
 * SPDX-License-Identifier: MIT
 */

/dts-v1/;
#include <nordic/nrf52833_qiaa.dtsi>
#include <common/nordic/nrf52833_uf2_boot_mode.dtsi>
#include "skean.dtsi"

&default_transform {
	col-offset = <6>;
};

&crkbd_transform {
	col-offset = <6>;
};

&kscan0 {
	col-gpios
		= <&gpio1 9 GPIO_ACTIVE_HIGH>
		, <&gpio0 30 GPIO_ACTIVE_HIGH>
		, <&gpio0 13 GPIO_ACTIVE_HIGH>
		, <&gpio0 24 GPIO_ACTIVE_HIGH>
		, <&gpio0 9 GPIO_ACTIVE_HIGH>
		, <&gpio0 10 GPIO_ACTIVE_HIGH>
		;
};
